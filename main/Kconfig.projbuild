## main/Kconfig.projbuild
```kconfig
menu "BlueRetro"

    config BLUERETRO_HW2
        bool "Enable support for HW2 features"
        default y
        help
            Select this to enable HW2 features like port detection.

    choice
        prompt "Select universal or specific system"
        default BLUERETRO_SYSTEM_UNIVERSAL
        help
            BlueRetro is an universal adapter but you may force it to support
            only one system.

        config BLUERETRO_SYSTEM_UNIVERSAL
            bool "UNIVERSAL"
            help
                Select this to support all systems.

        config BLUERETRO_SYSTEM_PARALLEL_1P
            bool "PARALLEL_1P_PP"
            help
                Select this to support only PARALLEL_1P push-pull.

        config BLUERETRO_SYSTEM_PARALLEL_2P
            bool "PARALLEL_2P_PP"
            help
                Select this to support only PARALLEL_2P push-pull.

        config BLUERETRO_SYSTEM_NES
            bool "NES"
            help
                Select this to support only NES.

        config BLUERETRO_SYSTEM_PCE
            bool "PCE"
            help
                Select this to support only PCE.

        config BLUERETRO_SYSTEM_GENESIS
            bool "MEGADRIVE/GENESIS"
            help
                Select this to support only MEGADRIVE/GENESIS.

        config BLUERETRO_SYSTEM_SNES
            bool "SNES"
            help
                Select this to support only SNES.

        config BLUERETRO_SYSTEM_CDI
            bool "CD-i"
            help
                Select this to support only CD-i.

        config BLUERETRO_SYSTEM_CD32
            bool "CD32"
            help
                Select this to support only CD32.

        config BLUERETRO_SYSTEM_3DO
            bool "3DO"
            help
                Select this to support only 3DO.

        config BLUERETRO_SYSTEM_JAGUAR
            bool "JAGUAR"
            help
                Select this to support only JAGUAR.

        config BLUERETRO_SYSTEM_PSX_PS2
            bool "PSX/PS2"
            help
                Select this to support only PSX & PS2.

        config BLUERETRO_SYSTEM_SATURN
            bool "SATURN"
            help
                Select this to support only SATURN.

        config BLUERETRO_SYSTEM_PCFX
            bool "PC-FX"
            help
                Select this to support only PC-FX.

        config BLUERETRO_SYSTEM_JVS
            bool "JVS"
            help
                Select this to support only JVS.

        config BLUERETRO_SYSTEM_N64
            bool "N64"
            help
                Select this to support only N64.

        config BLUERETRO_SYSTEM_DC
            bool "DC"
            help
                Select this to support only DC.

        config BLUERETRO_SYSTEM_GC
            bool "GC"
            help
                Select this to support only GC.

        config BLUERETRO_SYSTEM_WII_EXT
            bool "Wii ext."
            help
                Select this to support only Wii ext.

        config BLUERETRO_SYSTEM_VBOY
            bool "VB"
            help
                Select this to support only VB.

        config BLUERETRO_SYSTEM_PARALLEL_1P_OD
            bool "PARALLEL_1P_OD"
            help
                Select this to support only PARALLEL_1P open drain.

        config BLUERETRO_SYSTEM_PARALLEL_2P_OD
            bool "PARALLEL_2P_OD"
            help
                Select this to support only PARALLEL_2P open drain.

        config BLUERETRO_SYSTEM_SEA_BOARD
            bool "SEA Board"
            help
                Select this to support only SEA Board.

    endchoice

    menu "Debug"

        config BLUERETRO_QEMU
            bool "Enable QEMU friendly config"
            help
                Select this to make an image for QEMU.

        config BLUERETRO_WS_CMDS
            bool "Enable websocket cmds"
            help
                Select this to enable websocket cmds.

        config BLUERETRO_BT_DISABLE
            bool "Disable Bluetooth init"
            help
                Select this to disable Bluetooth init.

        config BLUERETRO_BT_H4_TRACE
            bool "Enable Bluetooth H4 tracing"
            help
                Select this to enable Bluetooth H4 tracing.

        config BLUERETRO_BT_SSP_DBG
            bool "Enable Bluetooth SSP debug mode"
            help
                Select this to enable Bluetooth SSP debug mode.

        config BLUERETRO_GENERIC_HID_DEBUG
            bool "Enable Generic HID report debug"
            help
                Select this to enable Generic HID report debug.

        config BLUERETRO_DUMP_HID_DESC
            bool "Enable HID descriptor dump"
            help
                Select this to dump HID descriptor.

        config BLUERETRO_TEST_FALLBACK_REPORT
            bool "Enable testing fallback report"
            help
                Select this to test fallback report.

        config BLUERETRO_RAW_REPORT_DUMP
            bool "Enable RAW report dump"
            help
                Select this to dump RAW report data.

        config BLUERETRO_ADAPTER_BTNS_DBG
            bool "Enable adapter buttons debug"
            help
                Select this to enable adapter buttons debug.

        config BLUERETRO_ADAPTER_RUMBLE_DBG
            bool "Enable adapter rumble debug"
            help
                Select this to enable adapter rumble debug.

        config BLUERETRO_ADAPTER_RUMBLE_TEST
            bool "Enable adapter rumble test"
            help
                Select this to enable adapter rumble test.

        config BLUERETRO_ADAPTER_INPUT_DBG
            bool "Enable adapter input debug"
            help
                Select this to enable adapter input debug.

        config BLUERETRO_ADAPTER_INPUT_MAP_DBG
            bool "Enable adapter input mapping debug"
            help
                Select this to enable adapter input mapping debug.

        config BLUERETRO_WIRED_TRACE
            bool "Enable wired trace"
            help
                Select this to enable wired trace.

        config BLUERETRO_BT_TIMING_TESTS
            bool "Enable Bluetooth timing tests"
            help
                Select this to enable Bluetooth timeing tests.

        config BLUERETRO_BT_REPORT_INTERVAL_STATS
            bool "Print interval between receive Bluetooth HID report"
            depends on BLUERETRO_BT_TIMING_TESTS
            help
                Print interval between receive Bluetooth HID report.

        choice
            prompt "Enable Bluetooth minimum latency test on GPIO26"
            depends on BLUERETRO_BT_TIMING_TESTS
            optional
            help
                Select to enable Bluetooth minimum latency test.

            config BLUERETRO_BT_MIN_LATENCY_TEST_PS3
                bool "PS3"

            config BLUERETRO_BT_MIN_LATENCY_TEST_PS4
                bool "PS4"

            config BLUERETRO_BT_MIN_LATENCY_TEST_PS5
                bool "PS5"

            config BLUERETRO_BT_MIN_LATENCY_TEST_WIIU
                bool "WIIU"

            config BLUERETRO_BT_MIN_LATENCY_TEST_XB1
                bool "XB1"

            config BLUERETRO_BT_MIN_LATENCY_TEST_SW
                bool "SW"

        endchoice

        config BLUERETRO_BTMON_VERBOSE
            bool "Enable verbose loggin into BT monitor"
            help
                Seclect this to enable verbose loggin into BT monitor.

        config BLUERETRO_COVERAGE
            bool "Enable gcov coverage logging"
            help
                Seclect this to enable gcov coverage logging.

    endmenu

    menu "PS1 Custom Edition"

        config BR_PS1_BLINK
            bool "Blue LED blink on connection based on port (DS4/clones)"
            default y
            help
                Enables blue breathing blink N times for Player N upon connection on DS4 and clones.
                DualSense (DS5) does not use this blink (identifies via native player indicator LEDs).

        config BR_PS1_CONN_RUMBLE
            bool "Vibration confirmation pulse on connection"
            default y
            help
                Gives a gentle 150ms rumble pulse on the light motor upon controller connection.

        config BR_PS1_LED_ANALOG_COLOR
            hex "Lightbar color in Analog Mode"
            default 0x00006D
            help
                Lightbar color in the DS4/DS5 report byte order (0x00BBGGRR,
                i.e. byte 0 = red). Default 0x00006D = R=0x6D, G=0x00,
                B=0x00, the attenuated SCPH-1200 red (#6D0000).

        config BR_PS1_LED_DIGITAL_COLOR
            hex "Lightbar color in Digital Mode"
            default 0x101010
            help
                Lightbar color in the DS4/DS5 report byte order (0x00BBGGRR,
                i.e. byte 0 = red). Default 0x101010 = neutral grey (#101010).

        config BR_PS1_NIGHT_MODE
            bool "Night mode (reduced brightness)"
            default n
            help
                Reduces LED colors and breathing blink brightness by 50%, and sets DS5 player LEDs to low brightness.

        config BR_PS1_MEMORY_CARD
            bool "Virtual 128KB PS1 Memory Card in SPIFFS"
            default n
            help
                Enables internal 128KB PS1 memory card emulation. Consumes 128KB of DMA-capable heap.
                Disabled by default for dedicated controller adapter role, freeing 128KB heap for the Bluetooth stack.

        config BR_PS1_BATTERY_IND
            bool "Low battery amber pulse indicator"
            default n
            help
                Pulses amber LED every 30 seconds when controller battery level <= 20% and not charging.

        config BR_PS1_LATENCY_STATS
            bool "Log latency/packet stats to serial every 10s"
            default n
            help
                Prints SPI frames, idle resets, TX queue drops, and lock wait times every 10 seconds.

        config BR_PS1_LATENCY_PROBE
            bool "Enable GPIO latency probe for oscilloscope"
            default n
            help
                Pulses a free GPIO low on BT HID packet reception and high at SPI packet end.

        config BR_PS1_LATENCY_PROBE_GPIO
            int "GPIO number for latency probe"
            depends on BR_PS1_LATENCY_PROBE
            default 26
            help
                Free GPIO pin to use for latency measurement (do not use PS1 bus pins).

    endmenu

endmenu
```
